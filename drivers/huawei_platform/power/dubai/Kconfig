## drivers/huawei_platform/power/dubai/Kconfig
```kconfig
menu "Huawei Device Usage Big-data Analytics Initiative Support"

config HUAWEI_DUBAI
	tristate "Huawei Device Usage Big-data Analytics Initiative Support"
	default n
	---help---
	  This driver provides DUBAI feature

endmenu
```

## drivers/huawei_platform/touthscreen/panel/Kconfig
```kconfig
#
# huawei touchscreen driver configuration
#

config SYNAPTICS_TS
	bool "synaptics touchscreen"
	default n
	help
	  If you say yes here you get support for synaptics touchscreen.
config SYNAPTICS_LCD_TYPE
	bool "synaptics lcd type"
	default n
	help
	  If you say yes here you get support for synaptics touchscreen.
config CYPRESS_TS
	bool "cypress touchscreen"
	default n
	help
	  If you say yes here you get support for cypress touchscreen.
config ATMEL_TS
	bool "atmel touchscreen"
	default n
	help
	  If you say yes here you get support for atmel touchscreen.
config HIDEEP_TS
	bool "hideep crimson touchscreen"
	default n
	help
	  If you say yes here you get support for hideep touchscreen.
menuconfig HW_NOVATEK_TS
	bool "novatek touchscreen"
	default n
	help
	  If you say yes here you get support for novatek touchscreen.
menuconfig ST_TS
	bool "st touchscreen"
	default n
	help
	  If you say yes here you get support for st touchscreen.
menuconfig GOODIX_TS
	bool "goodix touchscreen"
	default n
	help
	  If you say yes here you get support for goodix touchscreen.
```

## drivers/huawei_platform/usb/Kconfig
```kconfig
source "drivers/huawei_platform/usb/switch/Kconfig" 
source "drivers/huawei_platform/usb/otg_gpio_switch/Kconfig"
source "drivers/huawei_platform/usb/typec/Kconfig"
source "drivers/huawei_platform/usb/pd/Kconfig"
source "drivers/huawei_platform/usb/otg_gpio_id/Kconfig"
source "drivers/huawei_platform/usb/superswitch/Kconfig"
source "drivers/huawei_platform/usb/otg_dual_role/Kconfig"
source "drivers/huawei_platform/usb/cc_anti_corrosion/Kconfig"
config SUPERSWITCH
	tristate "superswitch support"
	help
	  Say Y here to enable superswitch support.
```

## drivers/huawei_platform/usb/cc_anti_corrosion/Kconfig
```kconfig
config CC_ANTI_CORROSION
	tristate "CC_ANTI_CORROSION support"
	default n
	depends on GPIOLIB
	help
	  Say Y here to enable GPIO based switch support.
```

## drivers/huawei_platform/usb/pd/Kconfig
```kconfig
source "drivers/huawei_platform/usb/pd/ti/Kconfig"
source "drivers/huawei_platform/usb/pd/richtek/Kconfig"
```

## drivers/hwbfm/Kconfig
```kconfig
#
# huawei device state monitor configuration
#

config HUAWEI_BFM
	bool "huawei BFM"
	default n
	help
	  If you say yes here you get support for huawei boot fail monitor solution.

config HW_BFMR_HISI
	bool "bfmr for hisi"
	default n
	help
	  If you say yes here you get support for huawei bfmr solution on hisi.

config HW_BFMR_QCOM
	bool "bfmr for qcom"
	default n
	help
	  If you say yes here you get support for huawei bfmr solution on qcom.

config USE_BOOTFAIL_RECOVERY_SOLUTION
    bool "use bootfail recovery solution"
    default n
    help
      If you say yes here you get support for huawei bfmr solution
      
source "drivers/hwbfm/hwbfr/Kconfig"
```

## drivers/hwzerohung/Kconfig
```kconfig
config HW_ZEROHUNG
	depends on HW_LOGGER
	bool "Huawei zero hung driver"
	default n
	---help---
	  This feature support to catch hung log
```

## drivers/media/huawei/camera/Kconfig
```kconfig
comment "Huawei Camera"

# source "drivers/media/huawei/camera/isp/Kconfig"
source "drivers/media/huawei/camera/hisp/Kconfig"
source "drivers/media/huawei/camera/sensor/Kconfig"
source "drivers/media/huawei/camera/laser/Kconfig"
source "drivers/media/huawei/camera/fd/Kconfig"



if HISI_CAMERA_HISTAR_ISPV160
source "drivers/media/huawei/camera/platform/kirin970/Kconfig"
endif

if HISI_CAMERA_HISTAR_ISPV150
source "drivers/media/huawei/camera/platform/hi3660/Kconfig"
endif

if HISI_CAMERA_HISTAR_ISPV110
source "drivers/media/huawei/camera/platform/hi6250/Kconfig"
endif

menuconfig HISI_CAMERA_LASER
    bool "Huawei laser support"
    default n
    help
        Say Y here to enable Laser for Huawei camera

menuconfig HISI_CAMERA_FLASH
    bool "Huawei flash support"
    default n
    help
        Say Y here to enable Flash for Huawei camera

config HISI_CAMERA_HISTAR_ISPV110
    tristate "Support histar ispv110 driver"
    depends on HUAWEI_CAMERA
    default n
    ---help---
        Hisilicon histar ispv110 driver.

config HISI_CAMERA_HISTAR_ISPV150
    tristate "Support histar ispv150 driver"
    depends on HUAWEI_CAMERA
    default n
    ---help---
        Hisilicon histar ispv150 driver.

config HISI_CAMERA_HISTAR_ISPV160
    tristate "Support histar ispv160 driver"
    depends on HUAWEI_CAMERA
    default n
    ---help---
        Hisilicon histar ispv160 driver.

config HISI_CAMERA_HISTAR_ISPV120
    tristate "Support histar ispv120 driver"
    depends on HUAWEI_CAMERA
    default n
    ---help---
        Hisilicon histar ispv120 driver.

config HISI_CAMERA_HISTAR_ISPV200
    tristate "Support histar ispv200 driver"
    depends on HUAWEI_CAMERA
    default n
    ---help---
        Hisilicon histar ispv200 driver.

config HISI_CAMERA_ISP_SECURE
    tristate "Support histar isp secure"
    depends on HUAWEI_CAMERA
    default n
    ---help---
        Hisilicon histar isp secure.
```

## drivers/media/huawei/camera/platform/hi3660/Kconfig
```kconfig
comment "Huawei Sensor hi3660"

source "drivers/media/huawei/camera/sensor/vcm/Kconfig"
source "drivers/media/huawei/camera/sensor/flash/Kconfig"
source "drivers/media/huawei/camera/sensor/ois/Kconfig"

config HUAWEI_CAMERA_USE_IMX230
	bool "imx230"
    default y
	depends on HUAWEI_CAMERA

config HUAWEI_CAMERA_USE_IMX298
	bool "imx298"
    default y
    depends on HUAWEI_CAMERA

config HUAWEI_CAMERA_USE_IMX298HYBIRD
    bool "imx298hybird"
    default y
    depends on HUAWEI_CAMERA

config HUAWEI_CAMERA_USE_IMX179
	bool "imx179"
    default y
	depends on HUAWEI_CAMERA

config HUAWEI_CAMERA_USE_IMX179_CMB
	bool "imx179_cmb"
    default n
	depends on HUAWEI_CAMERA

config HUAWEI_CAMERA_USE_IMX286DUAL
	bool "imx286dual"
    default y
	depends on HUAWEI_CAMERA

config HUAWEI_CAMERA_USE_IMX286DUAL_CMB
	bool "imx286dual_cmb"
    default n
	depends on HUAWEI_CAMERA

config HUAWEI_CAMERA_USE_IMX286DUAL_DUKE
	bool "imx286dual_duke"
    default n
	depends on HUAWEI_CAMERA

config HUAWEI_CAMERA_USE_OV8865
	bool "ov8865"
    default y
	depends on HUAWEI_CAMERA

config HUAWEI_CAMERA_USE_IMX286HYBIRD
	bool "imx286hybird"
    default y
	depends on HUAWEI_CAMERA

config HUAWEI_CAMERA_USE_IMX386HYBIRD
	bool "imx386hybird"
    default y
	depends on HUAWEI_CAMERA

config HUAWEI_CAMERA_USE_IMX486HYBIRD
	bool "imx486hybird"
    default y
	depends on HUAWEI_CAMERA


config HUAWEI_CAMERA_USE_IMX219
	bool "imx219"
    default n
	depends on HUAWEI_CAMERA

config HUAWEI_CAMERA_USE_IMX219_VIC
	bool "imx219_vic"
    default y
	depends on HUAWEI_CAMERA

config HUAWEI_CAMERA_USE_IMX319
	bool "imx319"
    default y
	depends on HUAWEI_CAMERA

config HUAWEI_CAMERA_USE_IMX219_DUKE
	bool "imx219_duke"
    default n
	depends on HUAWEI_CAMERA

config HUAWEI_CAMERA_USE_IMX219_STF
	bool "imx219_stf"
    default n
	depends on HUAWEI_CAMERA

config HUAWEI_CAMERA_USE_HI843
	bool "hi843"
    default n
	depends on HUAWEI_CAMERA

config HUAWEI_CAMERA_USE_HI843_DUKE
	bool "hi843_duke"
    default n
	depends on HUAWEI_CAMERA

config HUAWEI_CAMERA_USE_OV8856_DUKE
	bool "ov8856_duke"
    default n
	depends on HUAWEI_CAMERA

config HUAWEI_CAMERA_USE_OV8856_STF
	bool "ov8856_stf"
    default n
	depends on HUAWEI_CAMERA

config HUAWEI_CAMERA_USE_HI843_STF
	bool "hi843_stf"
    default n
	depends on HUAWEI_CAMERA

config HUAWEI_CAMERA_USE_OV2281
	bool "ov2281"
    default y
	depends on HUAWEI_CAMERA

config HUAWEI_CAMERA_USE_IMX386HYBIRD_STF
	bool "imx386hybird_stf"
    default n
	depends on HUAWEI_CAMERA

config HUAWEI_CAMERA_USE_IMX486HYBIRD_OIS_NA
	bool "imx486hybird_stf"
    default n
	depends on HUAWEI_CAMERA

config HUAWEI_CAMERA_USE_OV12A10HYBIRD_STF
	bool "ov12a10hybird_stf"
    default n
	depends on HUAWEI_CAMERA

config HUAWEI_CAMERA_USE_OV16B10HYBIRD_HWI
	bool "ov16b10hybird_hwi"
    default n
	depends on HUAWEI_CAMERA

config HUAWEI_CAMERA_USE_IMX498HYBIRD_HWI
	bool "imx498hybird_hwi"
    default n
	depends on HUAWEI_CAMERA

config HUAWEI_CAMERA_USE_OV20880_HWI
        bool "ov20880_hwi"
    default n
        depends on HUAWEI_CAMERA

config HUAWEI_CAMERA_USE_IMX376_HWI
        bool "imx376_hwi"
    default n
        depends on HUAWEI_CAMERA

config HUAWEI_CAMERA_USE_GC2375_HWI
        bool "gc2375_hwi"
    default n
        depends on HUAWEI_CAMERA

config HUAWEI_CAMERA_USE_HI259B_HWI
        bool "hi259b"
    default n
        depends on HUAWEI_CAMERA

config HUAWEI_CAMERA_USE_IMX318
    bool "imx318"
    default n
    depends on HUAWEI_CAMERA

config HUAWEI_CAMERA_USE_IMX258
        bool "imx258"
    default n
        depends on HUAWEI_CAMERA

config HUAWEI_CAMERA_USE_OV13855
        bool "ov13855"
    default n
        depends on HUAWEI_CAMERA

config HUAWEI_CAMERA_USE_OV8856_SHT
        bool "ov8856sht_ofilm"
    default n
        depends on HUAWEI_CAMERA

config HUAWEI_CAMERA_USE_HI846
        bool "hi846"
    default n
        depends on HUAWEI_CAMERA
```
