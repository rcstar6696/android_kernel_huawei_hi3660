## drivers/scsi/ufs/Kconfig
```kconfig
#
# Kernel configuration file for the UFS Host Controller
#
# This code is based on drivers/scsi/ufs/Kconfig
# Copyright (C) 2011-2013 Samsung India Software Operations
#
# Authors:
#	Santosh Yaraganavi <santosh.sy@samsung.com>
#	Vinayak Holikatti <h.vinayak@samsung.com>
#
# This program is free software; you can redistribute it and/or
# modify it under the terms of the GNU General Public License
# as published by the Free Software Foundation; either version 2
# of the License, or (at your option) any later version.
# See the COPYING file in the top-level directory or visit
# <http://www.gnu.org/licenses/gpl-2.0.html>
#
# This program is distributed in the hope that it will be useful,
# but WITHOUT ANY WARRANTY; without even the implied warranty of
# MERCHANTABILITY or FITNESS FOR A PARTICULAR PURPOSE.  See the
# GNU General Public License for more details.
#
# This program is provided "AS IS" and "WITH ALL FAULTS" and
# without warranty of any kind. You are solely responsible for
# determining the appropriateness of using and distributing
# the program and assume all risks associated with your exercise
# of rights with respect to the program, including but not limited
# to infringement of third party rights, the risks and costs of
# program errors, damage to or loss of data, programs or equipment,
# and unavailability or interruption of operations. Under no
# circumstances will the contributor of this Program be liable for
# any damages of any kind arising from your use or distribution of
# this program.

config SCSI_UFSHCD
	tristate "Universal Flash Storage Controller Driver Core"
	depends on SCSI && SCSI_DMA
	---help---
	This selects the support for UFS devices in Linux, say Y and make
	  sure that you know the name of your UFS host adapter (the card
	  inside your computer that "speaks" the UFS protocol, also
	  called UFS Host Controller), because you will be asked for it.
	  The module will be called ufshcd.

	  To compile this driver as a module, choose M here and read
	  <file:Documentation/scsi/ufs.txt>.
	  However, do not compile this as a module if your root file system
	  (the one containing the directory /) is located on a UFS device.

config SCSI_UFSHCD_PCI
	tristate "PCI bus based UFS Controller support"
	depends on SCSI_UFSHCD && PCI
	---help---
	This selects the PCI UFS Host Controller Interface. Select this if
	you have UFS Host Controller with PCI Interface.

	  If you have a controller with this interface, say Y or M here.

	  If unsure, say N.

config SCSI_UFSHCD_PLATFORM
	tristate "Platform bus based UFS Controller support"
	depends on SCSI_UFSHCD
	---help---
	This selects the UFS host controller support. Select this if
	you have an UFS controller on Platform bus.

	If you have a controller with this interface, say Y or M here.

	  If unsure, say N.

config SCSI_UFS_QCOM
	bool "QCOM specific hooks to UFS controller platform driver"
	depends on SCSI_UFSHCD_PLATFORM && ARCH_MSM
	select PHY_QCOM_UFS
	help
	  This selects the QCOM specific additions to UFSHCD platform driver.
	  UFS host on QCOM needs some vendor specific configuration before
	  accessing the hardware which includes PHY configuration and vendor
	  specific registers.

	  Select this if you have UFS controller on QCOM chipset.
	  If unsure, say N.

config SCSI_UFS_KIRIN
	  tristate "KIRIN UFS Host Controller Driver"
	  depends on SCSI_UFSHCD && SCSI_UFSHCD_PLATFORM
	  ---help---
	  This selects the KIRIN UFS host controller driver.

	  If you have a controller with this interface, say Y or M here.

	  If unsure, say N.

config SCSI_UFS_KIRIN_LINERESET_CHECK
	  bool "KIRIN UFS background thread to check line-reset"
	  depends on SCSI_UFSHCD && SCSI_UFS_KIRIN
	  ---help---
	  This create a thread to check line-reset bug, and recovery it.

	  If using Kirin960, say Y here.

	  If unsure, say N.

config SCSI_UFS_FAULT_INJECT
	  tristate "UFS Fault Inject"
	  depends on SCSI_UFSHCD && FAULT_INJECTION && FAULT_INJECTION_DEBUG_FS
	  ---help---
	  This adds the UFS Fault Inject Interface to the ufshcd.
	  The infrastructure can be used for debugging the driver from user space
	  by injecting fault to the driver.

	  Select this if you want to enable fault injection.
	  If unsure, say N.

config SCSI_UFS_TEST
	tristate "Universal Flash Storage host controller driver unit-tests"
	depends on SCSI_UFSHCD
	---help---
	This adds UFS Host controller unit-test framework.
	The UFS unit-tests register as a block device test utility to
	the test-iosched and will be initiated when the test-iosched will
	be chosen to be the active I/O scheduler.

config SCSI_UFS_INLINE_CRYPTO
	tristate "UFS inline crytpo driver based on Kirin UFS Host Controller"
	depends on HISI_BLK_INLINE_CRYPTO && SCSI_UFSHCD && SCSI_UFS_KIRIN

	---help---
	This selects the Kirin UFS inline crypto driver.

	Select this if you want to use Hardware Crypto Engine
	and using its interface for some special cryto func.
	Otherwise, if you love my driver code, say Y or M here.

	If unsure, say N.

config SCSI_UFS_ENHANCED_INLINE_CRYPTO
	tristate "UFS inline crytpo driver based on Kirin UFS Host Controller"
	depends on SCSI_UFS_INLINE_CRYPTO

	---help---
	This selects the Kirin UFS inline enhanced crypto driver.

	Select this if you want to use Hardware Crypto Engine
	and using its interface for some special cryto func.
	Otherwise, if you love my driver code, say Y or M here.

	If unsure, say N.

config SCSI_UFS_HS_ERROR_RECOVER
	tristate "UFS use this config to recover ufs hs error"
	depends on SCSI_UFSHCD && SCSI_UFS_KIRIN

	---help---
	This selects the recovery of error in HS_MODE.

	Select this if needed to recover error in HS_MODE.

	If unsure, say N.

config SCSI_UFS_BLOCK_TEST
	tristate "Universal Flash Storage host controller driver unit-tests"
	depends on SCSI_UFSHCD && IOSCHED_TEST
	---help---
	This adds UFS Host controller unit-test framework.
	The UFS unit-tests register as a block device test utility to
	the test-iosched and will be initiated when the test-iosched will
	be chosen to be the active I/O scheduler.

config HUAWEI_UFS_DSM
       bool "Listen UFS Kernel Error"
       depends on SCSI_UFSHCD

config SCSI_UFS_HIVV_VCMD
	bool "UFS HiVV Device Vendor Command"
	depends on SCSI_UFSHCD
	---help---
	This adds UFS Hisilicon Device defined vendor command.
	contained that query fsr and so on.

config SCSI_UFS_KIRIN_V21
	  tristate "KIRIN V21 UFS Host Controller Driver"
	  depends on SCSI_UFSHCD && SCSI_UFSHCD_PLATFORM && SCSI_UFS_KIRIN
	  ---help---
	  This selects the KIRIN V21 UFS host controller driver.

	  If you have a controller with this interface, say Y or M here.

	  If unsure, say N.

config HISI_UFS_MANUAL_BKOPS
       bool "hisi manual BKOPS support for UFS"
       depends on HISI_MANUAL_BKOPS && SCSI_UFSHCD
       default n

config HUAWEI_UFS_VENDOR_MODE
       bool "Enter UFS vendor mode"
       depends on SCSI_UFSHCD
```

## drivers/staging/android/ion/Kconfig
```kconfig
menuconfig ION
	bool "Ion Memory Manager"
	depends on HAVE_MEMBLOCK && HAS_DMA && MMU
	select GENERIC_ALLOCATOR
	select DMA_SHARED_BUFFER
	---help---
	  Chose this option to enable the ION Memory Manager,
	  used by Android to efficiently allocate buffers
	  from userspace that can be shared between drivers.
	  If you're not using Android its probably safe to
	  say N here.

config ION_TEST
	tristate "Ion Test Device"
	depends on ION
	help
	  Choose this option to create a device that can be used to test the
	  kernel and device side ION functions.

config ION_DUMMY
	bool "Dummy Ion driver"
	depends on ION
	help
	  Provides a dummy ION driver that registers the
	  /dev/ion device and some basic heaps. This can
	  be used for testing the ION infrastructure if
	  one doesn't have access to hardware drivers that
	  use ION.

config ION_TEGRA
	tristate "Ion for Tegra"
	depends on ARCH_TEGRA && ION
	help
	  Choose this option if you wish to use ion on an nVidia Tegra.

config ION_POOL_CACHE_POLICY
	bool "Ion set page pool cache policy"
	depends on ION && X86
	default y if X86
	help
	  Choose this option if need to explicity set cache policy of the
	  pages in the page pool.

config ION_HISI
	tristate "Hisilicon ION driver"
	depends on ION
	help
	  Choose this option if you wish to use ion on an HISI target.

config ION_HISI_CPUDRAW
	bool "Hisilicon ION cpudraw heap support"
	depends on ION_HISI
	help
	  If you want to use cpu draw the first graph layer on hisilicon
	  platfrom, you should select this.But now this is usually used
	  for debug.

config ION_HISI_SECCM
	bool "Hisilicon ION seccm heap support"
	depends on ION_HISI
	help
	 if you want to use seccm heap, you should select this.

config ION_HISI_SECSG
	bool "Hisilicon ION secsg heap support"
	depends on ION_HISI
	help
	 if you want to use secsg heap, you should select this.

config HISI_ION_SECSG_DEBUG
	bool "Hisilicon ION secsg heap support"
	depends on ION_HISI_SECSG
	default n
	help
	  if you want to debug ion secsg, you should select this.

config ION_HISI_DMA_POOL
	bool "Hisilicon ION DMA pool heap support"
	depends on ION_HISI
	help
	  if you want to use DMA pool heap, you should select this.

config ION_HISI_FAMA_MISC
	bool "Hisilicon ION fama misc heap support"
	depends on ION_HISI
	help
	 if you want to use fama misc heap, you should select this.

config ION_HISI_SUPPORT_4GPLUS
	bool "Hisilicon ION can support allocation above 4G"
	depends on ION
	default n
	help
	  If the media IP can access the memory which is above 4G.
	  you should select this.

config HISI_SMARTPOOL_OPT
	bool "Support Hisilicon Smartpool"
	default n
	help
	  This driver supports Hisilicon Smartpool.

config HISI_SPECIAL_SCENE_POOL
	bool "Support Hisilicon Special Scenes Pool"
	default n
	help
	  This driver supports Hisilicon Special Scenes Pool.
```

## drivers/usb/proxy-hcd/Kconfig
```kconfig
config USB_PROXY_HCD
	tristate "Hisilicon Proxy Host Controller Driver"
	depends on USB
	help
	  Say Y here if your system has a USB Host Controller that can be
	  accessed via proxy.
config USB_PROXY_HCD_DEBUG
	bool "Hisilicon Proxy Host Controller Driver Debug"
	depends on USB_PROXY_HCD
	help
	  enable proxy HCD debug or not.
```

## drivers/vcodec/hi_vcodec/Kconfig
```kconfig
menu "VCODEC DRIVER Configuration"

config VCODEC_PLATFORM_HI3660
        tristate "3660 Vcodec configs"
        default n

config VCODEC_PLATFORM_KIRIN970
        tristate "970 Vcodec configs"
        default n

if VCODEC_PLATFORM_HI3660
source "drivers/vcodec/hi_vcodec/vdec/Kconfig"
source "drivers/vcodec/hi_vcodec/venc/drv/venc/Kconfig"
endif


if VCODEC_PLATFORM_KIRIN970
source "drivers/vcodec/hi_vcodec/vdec_hivna/Kconfig"
source "drivers/vcodec/hi_vcodec/venc_hivna/drv/venc/Kconfig"
endif

endmenu
```

## drivers/vcodec/hi_vcodec/venc_hivna_v210/drv/venc/Kconfig
```kconfig
menu "Hisilicon video venc support"
config HI_VCODEC_VENC
    #depends on ANDROID_PMEM
    tristate "Support for venc"
    default n
    help
        The decode device provides venc function
endmenu
```

## mm/hisi/Kconfig
```kconfig
menuconfig HISI_MM
	bool "Hisilicon MM support"
	---help---
	  This option add some hisilicon mm codes, needed by following modules.

if HISI_MM

config HISI_SLOW_PATH_COUNT
	bool "page alloc enter slow path count"
	default n
	help
	  Say 'Y' here is you want to count page alloc slow path.

endif
```

## security/kernel_harden/Kconfig
```kconfig
#
# Huawei Kernel Harden
#

menu "Huawei Kernel Harden"

config HUAWEI_KERNEL_STACK_RANDOMIZE
    bool "stack randomize"
    depends on ARM64 && !KASAN
    default n
    help
    Randomizes the base address of process's kernel stack.

config HUAWEI_KERNEL_STACK_RANDOMIZE_STRONG
    bool "stack randomize strong"
    depends on ARM64 && !KASAN
    default n
    help
    Randomizes the base address of process's thread_info struct.

config HUAWEI_KERNEL_STACK_NX
    bool "stack non executeable"
    depends on ARM64
    default n
    help
    Set process's kernel stack with non execution.

config HUAWEI_KERNEL_MODULE_RANDOMIZE
    bool "module randomize"
    depends on ARM64
    default n
    help
    Randomizes the base address of loaded kernel module.

config HUAWEI_KASLR_DEBUGFS
	bool "kaslr debugfs interface"
	depends on DEBUG_FS
	default n
	help
	The debugfs interface for kaslr feature.

config HUAWEI_HIDESYMS
	bool "hide symbols"
	default n
	help
	Hide some sensitive kernel symbols

config HUAWEI_HIDESYMS_DEBUGFS
	bool "hide symbols debugfs interface"
	depends on HUAWEI_HIDESYMS && DEBUG_FS
	default n
	help
	Turn on the debugfs interface for hide symbols

config HUAWEI_PTRACE_POKE_ON
	bool "open ptrace poke parameter process"
	default n
	help
	Turn on the ptrace poke parameter process

endmenu
#a blank line must be existed
```
