## drivers/hisi/ddrc/Kconfig
```kconfig
config HISILICON_PLATFORM_DDRC
	bool "Hisilicon platform ddr controller support"
	default n
	help
	  Say yes here to support the hisilicon platform ddr controller

config HI3650_DDRC_FLUX
	bool "Hi3650 ddr bandwith statstic "
	default n

config HI6250_DDRC_FLUX
	bool "Hi6250 ddr bandwith statstic "
	default n

config HISI_DDRC_FLUX
	bool "Hisi ddr bandwith statstic "
	default n

config HISI_DDRC_SEC
	bool "hisi ddr secprotect"
	default n

config HI3660_DDR_AUTO_FSGT
       bool "hi3660 ddr autofs/autogt"
       default n

config KIRIN970_DDR_AUTO_FSGT
       bool "kirin970 ddr autofs/autogt"
       default n
```

## drivers/hisi/hhee/Kconfig
```kconfig
config HISI_HHEE
	bool "HISI HHEE support"
	default n
	help
	  Say yes here to support the HISI HHEE
```

## drivers/hisi/hisee/Kconfig
```kconfig
config HISI_HISEE
	depends on HISI_MAILBOX
	bool "Hisilicon hisee "
	default n
	help
	  Hi3xxx hisee driver
```

## drivers/hisi/hkip_test/Kconfig
```kconfig
config HISI_HHEE_DEBUG
	bool "HISI HHEE test support"
	depends on HISI_HHEE
	depends on !UBSAN && !KCOV && !KASAN
	default n
	help
	  Say yes here to support the HISI HHEE debug
```

## drivers/hisi/ics/Kconfig
```kconfig
#
# Cambricon IPU Platform Specific Drivers
#

menuconfig HISI_ICS_IPU_PLATFORM
	bool "Platform supoort for Cambricon IPU Device"
	default y
	help
	  Say Y here to get to see options for device drivers of various
	  Cambricon IPU platforms. This option itself does not add any kernel code.

	  If you say N, all options in this submenu will be skipped and disabled.

if HISI_ICS_IPU_PLATFORM

config HISI_ICS_IPU
	tristate "Cambricon IPU Driver"
	default y
	help
	  Cambricon IPU Platform driver.

endif # HISI_ICS_IPU_PLATFORM
```

## drivers/hisi/ivp/Kconfig
```kconfig
menu "Hisilicon IVP"

config HISI_IVP
     bool "hisilicon ivp support"
     default n
     help
          ivp driver for hi3650.

config IVP_SMMU
	bool "Hisilicon IVP SMMU Support"
	depends on IOMMU_API
	depends on HISI_IODOMAIN_API
	help
	  Hisilicon IVP IOMMU Support.

config IVP_SMMU_TEST
	bool "Hisilicon IVP SMMU TEST Support"
	depends on IVP_SMMU
	help
	  Hisilicon IVP IOMMU TEST Support.

choice
	prompt "IVP Platform"
	default IVP_HI3650
	depends on HISI_IVP
	help
	  select ivp platform private setting

config IVP_KIRIN970
	bool "kirin970"
	depends on HISI_IVP

config IVP_HI3660
	bool "hi3660"
	depends on HISI_IVP

config IVP_HI3650
	bool "hi3650"
	depends on HISI_IVP
endchoice
endmenu
```

## drivers/hisi/jpu/Kconfig
```kconfig
config HISI_JPU_970
    tristate "Support for Hisilicon JPEG processing unit"
    default n
    help
        The decode device provides decode function for JPEG.
```

## drivers/huawei_platform/emcom/smartcare/Kconfig
```kconfig
config HW_NETWORK_MEASUREMENT
	bool "Huawei Network Measurement System"
	depends on HUAWEI_EMCOM
	default n
```

## drivers/huawei_platform/net/Kconfig
```kconfig
source "drivers/huawei_platform/net/ipv4/Kconfig"
source "drivers/huawei_platform/net/hw_netfilter/Kconfig"
source "drivers/huawei_platform/net/commstat/Kconfig"
source "drivers/huawei_platform/net/qtaguid_pid/Kconfig"
source "drivers/huawei_platform/net/hw_dpi_mark/Kconfig"
```

## drivers/huawei_platform/net/ipv4/Kconfig
```kconfig
config HW_CROSSLAYER_OPT
	bool "Huawei network crosslayer optimization"
	default n

config HW_CROSSLAYER_OPT_DBG
	tristate "Huawei network crosslayer information collection"
	depends on HW_CROSSLAYER_OPT && m
	default n


config HW_WIFI
	bool "Huawei wifi tcp monitor support"
	default n

config HUAWEI_MSS_AUTO_CHANGE
        bool "Huawei MSS auto change function support"
        default n
```

## drivers/huawei_platform/oases/Kconfig
```kconfig
#
# OASES device configuration
#

config OASES
	tristate "OASES device"
	default y
	depends on ARM || ARM64
	help
	  Enable oases patch device

config OASES_SIGNATURE_SUPPORT
	tristate "OASES device signature support"
	default y
	depends on OASES && KEYS
	select CRYPTO
	select CRYPTO_SHA1
	select ASYMMETRIC_KEY_TYPE
	select ASYMMETRIC_PUBLIC_KEY_SUBTYPE
	select X509_CERTIFICATE_PARSER
	select PKCS7_MESSAGE_PARSER
	help
	  Enable oases patch device

config OASES_STATIC_PLTS
	tristate "OASES static PLTs"
	default y
	depends on OASES
	help
	  Enable static PLT allocation
```

## drivers/huawei_platform/power/Kconfig
```kconfig
source "drivers/huawei_platform/power/charger/Kconfig"
source "drivers/huawei_platform/power/coul/Kconfig"
source "drivers/huawei_platform/power/hw_kstate/Kconfig"
source "drivers/huawei_platform/power/hw_ptm/Kconfig"
source "drivers/huawei_platform/power/ate/Kconfig"
source "drivers/huawei_platform/power/bastet/Kconfig"
source "drivers/huawei_platform/power/smpl/Kconfig"
source "drivers/huawei_platform/power/usb_short_circuit_protect/Kconfig"
source "drivers/huawei_platform/power/cpu_buck/Kconfig"
source "drivers/huawei_platform/power/water_check/Kconfig"
source "drivers/huawei_platform/power/buckboost/Kconfig"
source "drivers/huawei_platform/power/pid_socket/Kconfig"
source "drivers/huawei_platform/power/wifi_filter/Kconfig"
source "drivers/huawei_platform/power/dubai/Kconfig"
```

## drivers/huawei_platform/power/charger/charger_ap/Kconfig
```kconfig
source "drivers/huawei_platform/power/charger/charger_ap/direct_charger/Kconfig"
config HUAWEI_CHARGER_AP
	bool "huawei charger ap"
	default n
config BQ2419X_CHARGER
	bool "bq2419x charger"
	default n
config BQ2429X_CHARGER
	bool "bq2429x charger"
	default n
config BQ25892_CHARGER
	bool "bq25892 charger"
	default n
config DUAL_CHARGER
	bool "dual charger"
	default n
config DIRECT_CHARGER
	bool "direct charger"
	default n
```

## drivers/huawei_platform/power/charger/charger_ap/direct_charger/loadswitch/dual_loadswitch/Kconfig
```kconfig
config DUAL_LOADSWITCH_FAN54151
	bool "dual_loadswitch_fan54151"
	default n
config DUAL_LOADSWITCH_RT9748
	bool "dual_loadswitch_rt9748"
	default n
```
