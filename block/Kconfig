## block/Kconfig
```kconfig
#
# Block layer core configuration
#
menuconfig BLOCK
       bool "Enable the block layer" if EXPERT
       default y
       help
	 Provide block layer support for the kernel.

	 Disable this option to remove the block layer support from the
	 kernel. This may be useful for embedded devices.

	 If this option is disabled:

	   - block device files will become unusable
	   - some filesystems (such as ext3) will become unavailable.

	 Also, SCSI character devices and USB storage will be disabled since
	 they make use of various block layer definitions and facilities.

	 Say Y here unless you know you really don't want to mount disks and
	 suchlike.

if BLOCK

config LBDAF
	bool "Support for large (2TB+) block devices and files"
	depends on !64BIT
	default y
	help
	  Enable block devices or files of size 2TB and larger.

	  This option is required to support the full capacity of large
	  (2TB+) block devices, including RAID, disk, Network Block Device,
	  Logical Volume Manager (LVM) and loopback.

	  This option also enables support for single files larger than
	  2TB.

	  The ext4 filesystem requires that this feature be enabled in
	  order to support filesystems that have the huge_file feature
	  enabled.  Otherwise, it will refuse to mount in the read-write
	  mode any filesystems that use the huge_file feature, which is
	  enabled by default by mke2fs.ext4.

	  The GFS2 filesystem also requires this feature.

	  If unsure, say Y.

config BLK_DEV_BSG
	bool "Block layer SG support v4"
	default y
	help
	  Saying Y here will enable generic SG (SCSI generic) v4 support
	  for any block device.

	  Unlike SG v3 (aka block/scsi_ioctl.c drivers/scsi/sg.c), SG v4
	  can handle complicated SCSI commands: tagged variable length cdbs
	  with bidirectional data transfers and generic request/response
	  protocols (e.g. Task Management Functions and SMP in Serial
	  Attached SCSI).

	  This option is required by recent UDEV versions to properly
	  access device serial numbers, etc.

	  If unsure, say Y.

config BLK_DEV_BSGLIB
	bool "Block layer SG support v4 helper lib"
	default n
	select BLK_DEV_BSG
	help
	  Subsystems will normally enable this if needed. Users will not
	  normally need to manually enable this.

	  If unsure, say N.

config BLK_DEV_INTEGRITY
	bool "Block layer data integrity support"
	select CRC_T10DIF if BLK_DEV_INTEGRITY
	---help---
	Some storage devices allow extra information to be
	stored/retrieved to help protect the data.  The block layer
	data integrity option provides hooks which can be used by
	filesystems to ensure better data integrity.

	Say yes here if you have a storage device that provides the
	T10/SCSI Data Integrity Field or the T13/ATA External Path
	Protection.  If in doubt, say N.

config BLK_DEV_THROTTLING
	bool "Block layer bio throttling support"
	depends on BLK_CGROUP=y
	default n
	---help---
	Block layer bio throttling support. It can be used to limit
	the IO rate to a device. IO rate policies are per cgroup and
	one needs to mount and use blkio cgroup controller for creating
	cgroups and specifying per device IO rate policies.

	See Documentation/cgroups/blkio-controller.txt for more information.

config BLK_DEV_HI_PRIO_FOR_FG
	bool "Block layer high priority for foreground requests support"
	depends on BLK_DEV_THROTTLING=y
	default n
	---help---
	Give high priority for foreground requests, reserve some tags for
	forground requests to make sure these requests have low lantency.

config BLK_CMDLINE_PARSER
	bool "Block device command line partition parser"
	default n
	---help---
	Enabling this option allows you to specify the partition layout from
	the kernel boot args.  This is typically of use for embedded devices
	which don't otherwise have any standardized method for listing the
	partitions on a block device.

	See Documentation/block/cmdline-partition.txt for more information.

config BLOCK_COMPAT
        bool
        depends on BLOCK && COMPAT
        default y

config BLK_MQ_REFCOUNT
	bool "blk-mq reference count"
	depends on BLOCK
	default n
	help
	  Blk-mq reference count mechanism instead of percpu-refcount.

config HISI_BLOCK_FREQUENCE_CONTROL
        bool "add ddr frequence request base on block layer."
        depends on BLOCK
        default n

config MMC_BLOCK_IOMMU_64BIT
        bool "Block bounce limit"
        depends on BLOCK
        default n
        help
          Blk-setting will use address >4G for IOMMU.

config HISI_BLK_CORE
	bool "hisi blk core feature"
	depends on BLOCK
	default n
	help
		hisi block core feature

config HISI_MANUAL_BKOPS
	bool "hisi manual BKOPS feature"
	depends on HISI_BLK_CORE
	default n
	help
		manual BKOPS feature for NAND flash based storage devices


config HISI_BLK_MQ
	bool "hisi blk-mq"
	depends on BLOCK
	depends on HISI_BLK_CORE
	help
	  hisi block multi queue

config HISI_MQ_DEBUG
	bool "HISI Multi Queue Debug"
	depends on BLOCK
	depends on HISI_BLK_CORE
	depends on HISI_BLK_MQ
	default n

config HISI_BLK_MQ_DUMP
	bool "HISI blk-mq dump"
	depends on BLOCK
	depends on HISI_BLK_CORE
	depends on HISI_BLK_MQ
	default n

config HISI_MQ_DISPATCH_DECISION
	bool "HISI Multi Queue dispatch strategy"
	depends on BLOCK
	depends on HISI_BLK_CORE
	depends on HISI_BLK_MQ
	default n

config HISI_MQ_USING_HOQ
	bool "HISI blk using Head Of Queue"
	depends on BLOCK
	depends on HISI_BLK_CORE
	depends on HISI_BLK_MQ
	default n

config HISI_MQ_USING_CP
	bool "HISI blk using Command Priority"
	depends on BLOCK
	depends on HISI_BLK_CORE
	depends on HISI_BLK_MQ
	default n

config HISI_IO_LATENCY_TRACE
	bool "HISI IO LATENCY trace"
	depends on BLOCK
	depends on HISI_BLK_CORE
	default n

config HISI_BLK_FLUSH_REDUCE
	bool "HISI FLUSH REDUCE"
	depends on BLOCK
	depends on HISI_BLK_CORE
	default n

config HISI_BLK_FUNCTION_TEST
	bool "HISI BLOCK FUNCTION TEST"
	depends on BLOCK
	default n

config HISI_PARTITION
        bool "hisi partition"
        default n

config HISI_PARTITION_HI3650
        bool "hi3650 partition"
        depends on HISI_PARTITION
        default n
        help
           config partition for hi3650 platform

config HISI_PARTITION_HI6250
        bool "hi6250 partition"
        depends on HISI_PARTITION
        default n
        help
           config partition for hi6250 platform

config HISI_PARTITION_HI3660
        bool "hi3660 partition"
        depends on HISI_PARTITION
        default n
        help
           config partition for hi3660 platform

config HISI_PARTITION_KIRIN970
        bool "kirin970 partition"
        depends on HISI_PARTITION
        default n
        help
           config partition for kirin970 platform

config HW_SYSTEM_WR_PROTECT
	bool "write protection function of system partitions."
	depends on BLOCK
	default n

config HISI_AB_PARTITION
	bool "AB partition support"
	default n
	help
	  Say Y here if storage uses ab partition table.
config HISI_BLK_INLINE_CRYPTO
	bool "Hisi HW inline crytpo support"
	depends on BLOCK
	depends on FS_ENCRYPTION
	default n

	help
	 Provide block support for HW inline crytpo support.

	 Select this if you want to use Hardware Crypto Engine
	 and using its interface for some special cryto func.

	 If unsure, say N, hehe!

config BLK_QUEUE_USR_CTRL
	bool "block queue ctrl interface for userspace"
	depends on BLOCK
	default n

source block/Kconfig.iosched

endif # BLOCK

menu "Partition Types"

source "block/partitions/Kconfig"

endmenu
```

## drivers/abns/Kconfig
```kconfig
#
# huawei device state monitor configuration
#

config HUAWEI_ABNS
	bool "huawei ABNS"
	default n
	help
	  If you say yes here you get support for huawei boot fail monitor solution.
```

## drivers/clk/hisi/peri_dvfs/Kconfig
```kconfig
config HISI_PERIDVFS
	bool "HISI PERIDVFS"
	default n
config HISI_PERI_FAST_AVS
	depends on HISI_PERIDVFS
	depends on HISI_MAILBOX
	bool "HISI PERI FAST AVS"
	default n
```

## drivers/connectivity/Kconfig
```kconfig
#
# Generic huawei hisi misc drivers configuration
#
menuconfig CONNECTIVITY_HI110X
	bool "Hisilicon Wireless Connectivity Support"
	---help---
	  If you want to use Hisilicon  Wireless Connectivity, you should set this,
	  and choose one product

if CONNECTIVITY_HI110X
config HI110X_DRIVER_PATH
	string "The Kernel Driver Path"
	default "drivers/connectivity/hisi"
config CONNECTIVITY_HI110X_HI6250
	bool "Connectivity diff between 6250 with 3650"
	default n
config CONNECTIVITY_HI110X_HI3650
	bool "Connectivity diff between 3650 with 6250"
	default n
config CONNECTIVITY_HI110X_HI3660
	bool "Connectivity diff between 3660 with 6250"
	default n
config CONNECTIVITY_HI110X_KIRIN660
	bool "Connectivity diff between 660 with 3650"
	default n
config CONNECTIVITY_HI110X_KIRIN970
	bool "Connectivity diff between 970 with 6250"
	default n
config CONNECTIVITY_HI110X_KIRIN980
	bool "Connectivity diff between 980 with 6250"
	default n

source "drivers/connectivity/hisi/Kconfig"
source "drivers/connectivity/hisi/platform/Kconfig"
source "drivers/connectivity/hisi/wifi/Kconfig"
endif
```

## drivers/contexthub/Kconfig
```kconfig
config CONTEXTHUB
	bool "Sensor CONTEXTHUB driver"
	depends on INPUTHUB || INPUTHUB_20
	default n
	help
	Sensor CONTEXTHUB driver.

config CONTEXTHUB_SHMEM
	bool "Sensor CONTEXTHUB SHMEM driver"
	depends on CONTEXTHUB
	default n
	help
	Say yes here if you want to configure contexthub share memory

config CONTEXTHUB_SHELL
	bool "Sensor CONTEXTHUB SHELL DBG driver"
	depends on CONTEXTHUB
	default n
	help
	Say yes here if you want to use contexthub shell dbg function

config CONTEXTHUB_PD
	bool "Sensor CONTEXTHUB PD driver"
	default n
	help
	Say yes here if you want to use contexthub pd function

config CONTEXTHUB_PLAYBACK
	bool "Sensor CONTEXTHUB playback driver"
	depends on CONTEXTHUB
	default n
	help
	Say yes here if you want to use contexthub playback function

config CONTEXTHUB_LOADMONITOR
	bool "Sensor CONTEXTHUB LOADMONITOR driver"
	depends on CONTEXTHUB
	default n
	help
	Say yes here if you want to use contexthub shell dbg function

source "drivers/contexthub/flp/Kconfig"
```

## drivers/contexthub/flp/Kconfig
```kconfig
#
# FLP driver configuration
#

menu "HISI FLP configuration"

config HISI_FLP
	bool "HISI FLP support"
	depends on  CONTEXTHUB
	default n
	---help---
	  Enable support for FLP driver

endmenu
```

## drivers/cpufreq/hisi/Kconfig.arm
```kconfig
config ARCH_HISI_MAXFREQ
	bool "Hisilicon platform cpu max freq recognition"
	depends on PM_OPP
	default n
	help
	  Hisilicon platform cpu max freq recognition.

config HISI_ENABLE_GET_VAL
	bool "Hisilicon get cpufreq param"
	default n
	help
	  Hisilicon get cpufreq param.

config HISI_ENABLE_HPM_DATA_COLLECT
	bool "Hisilicon get hpm volt param"
	depends on HISI_ENABLE_GET_VAL
	default n
	help
	  Hisilicon get avs hpm volt param.

config HISI_BIG_MAXFREQ_HOTPLUG
	tristate "Specific flow for Hisilicon Platform CPUfreq driver"
	depends on CPUFREQ_DT && HOTPLUG_CPU
	help
	  This add Hotplug Flow in CPUfreq for Hisilicon Big-little Platform with boost freq.

config HISI_CPUFREQ_DT
	bool "Hisilicon cpufreq-dt enable"
	depends on CPUFREQ_DT
	default n
	help
	  Hisilicon cpufreq-dt enable.

config HISI_HW_VOTE_CPU_FREQ
	bool "Hisilicon cpufreq-hw_vote enable"
	depends on HISI_CPUFREQ_DT
	default n
	help
	  Hisilicon cpufreq-hw_vote enable.

config HISI_L2_DYNAMIC_RETENTION
	bool "Hisilicon l2 dynamic retention by freq"
	depends on HISI_HW_VOTE_CPU_FREQ
	default n
	help
	  Hisilicon l2 dynamic retention.

config HISI_CPUDDR_FREQ_LINK
	bool "Hisilicon cpu ddr freq link enable"
	depends on CPUFREQ_DT
	default n
	help
	  Hisilicon cpu ddr freq link enable.

config CPU_FREQ_POWER_STAT
	bool "Estimation of task power consumption"
	depends on CPU_FREQ_STAT
	default n
	help
	  Keep track of amount of power each task consumes and report power per uid
```

## drivers/devkit/lcdkit/Kconfig
```kconfig
#
# lcdkit driver configuration
#

source "drivers/devkit/lcdkit/core/common/Kconfig"
```

## drivers/devkit/tpkit/hostprocessing/Kconfig
```kconfig
#
# huawei hostprocessing ts driver configuration
#

menuconfig JDI_HOST_TS_KIT
	tristate "JDI_HOST ts drivers"
	default n
	help
	  If you say yes here you get support for jdi hostprocessing ts touchscreen.

menuconfig HUAWEI_THP
	tristate "HUAWEI thp core drivers"
	default n
	help
	  If you say yes here you get support for core capacity hostprocessing touchscreen.

menuconfig HUAWEI_THP_NOVATECH
	tristate "Novatech thp drivers"
	default n
	help
	  If you say yes here you get support for novatech hostprocessing touchscreen.
```

## drivers/gpu/arm/Kconfig
```kconfig
#
# (C) COPYRIGHT 2012 ARM Limited. All rights reserved.
#
# This program is free software and is provided to you under the terms of the
# GNU General Public License version 2 as published by the Free Software
# Foundation, and any use by you of this program is subject to the terms
# of such GNU licence.
#
# A copy of the licence is included with the program, and can also be obtained
# from Free Software Foundation, Inc., 51 Franklin Street, Fifth Floor,
# Boston, MA  02110-1301, USA.
#
#

config MALI_PLATFORM_HI6250
        tristate "6250 Mali configs"
        default n

config MALI_PLATFORM_HI3660
        tristate "3660 Mali configs"
        default n

config MALI_PLATFORM_KIRIN970
        tristate "970 Mali configs"
        default n

menu "ARM GPU Configuration"

if MALI_PLATFORM_HI6250
endif

if MALI_PLATFORM_HI3660
source "drivers/gpu/arm/bifrost-r8p0-00cet0/Kconfig"
endif

if MALI_PLATFORM_KIRIN970
source "drivers/gpu/arm/bifrost-r8p0-00cet0/Kconfig"
endif

endmenu
```

## drivers/hisi/Kconfig
```kconfig
menu "Hisilicon platform"

menuconfig HISILICON_PLATFORM
	bool "Hisilicon platform support"
	default n
	help
	  Say yes here to support the hisilicon platform

if HISILICON_PLATFORM

source "drivers/hisi/adc/Kconfig"
source "drivers/hisi/cci_extra/Kconfig"
source "drivers/hisi/cmdline/Kconfig"
source "drivers/hisi/irq_affinity/Kconfig"
source "drivers/hisi/mailbox/Kconfig"
source "drivers/hisi/mntn/Kconfig"
source "drivers/hisi/noc/Kconfig"
source "drivers/hisi/hisi_syscounter/Kconfig"
source "drivers/hisi/soundtrigger/Kconfig"
source "drivers/hisi/memory_dump/Kconfig"
source "drivers/hisi/hmpthresholds/Kconfig"
source "drivers/hisi/drmdriver/Kconfig"
source "drivers/hisi/efuse/Kconfig"
source "drivers/hisi/hi64xx/Kconfig"
source "drivers/hisi/hi64xx_dsp/Kconfig"
source "drivers/hisi/slimbus/Kconfig"
source "drivers/hisi/hifi_dsp/Kconfig"
source "drivers/hisi/hifi_mailbox/Kconfig"
source "drivers/hisi/ddrc/Kconfig"
source "drivers/hisi/hisi_cma/Kconfig"
source "drivers/hisi/tzdriver/Kconfig"
source "drivers/hisi/hisee/Kconfig"
source "drivers/hisi/load_image/Kconfig"
source "drivers/hisi/perfhub/Kconfig"
source "drivers/hisi/jpu/Kconfig"
source "drivers/hisi/pm/Kconfig"
source "drivers/hisi/ocbc/Kconfig"
source "drivers/hisi/modem/Kconfig"
source "drivers/hisi/axi/Kconfig"
source "drivers/hisi/ivp/Kconfig"
source "drivers/hisi/hisi_page_tracker/Kconfig"
source "drivers/hisi/hisi_page_ext/Kconfig"
source "drivers/hisi/hilog/Kconfig"
source "drivers/hisi/timekeeper/Kconfig"
source "drivers/hisi/tlb_conflict/Kconfig"
source "drivers/hisi/hisi_lmk/Kconfig"
source "drivers/hisi/test_spinlock/Kconfig"
source "drivers/hisi/hhee/Kconfig"
source "drivers/hisi/ics/Kconfig"
source "drivers/hisi/hkip_test/Kconfig"
source "drivers/hisi/dieid/Kconfig"

endif #HISILICON_PLATFORM

endmenu
```
