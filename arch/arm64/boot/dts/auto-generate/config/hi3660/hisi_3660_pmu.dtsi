  /{
	pmu {
		compatible = "arm,armv8-pmuv3";
		status="okay";
		interrupts = <0 24 4>,
			     <0 25 4>,
			     <0 26 4>,
			     <0 27 4>,
			     <0 2 4>,
			     <0 3 4>,
			     <0 4 4>,
			     <0 5 4>;
	};
};
